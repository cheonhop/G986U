## kernel/arch/arm64/Kconfig.projects
```kconfig
config SEC_Y2Q_PROJECT
	select SLUB_DEBUG if SEC_FACTORY
	select SLUB_DEBUG_ON if SEC_FACTORY
	default n
	bool "Samsung Y2Q Project"
	help
	  Support for Samsung Y2Q Project

config MACH_Y2Q_USA_SINGLE
	default n
	bool "Samsung Y2Q USA SQ"
	help
	  Support for Samsung Y2Q USA SQ device.
```
